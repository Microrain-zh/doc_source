

   sr04 {  /* for stm32mp157 */
        compatible = "100ask,sr04";
        trig-gpios = <&gpioa 5 GPIO_ACTIVE_HIGH>;
        echo-gpios = <&gpioa 13 GPIO_ACTIVE_HIGH>;
    };


   sr04 {  /* for imx6ull */
        compatible = "100ask,sr04";
        trig-gpios = <&gpio4 19 GPIO_ACTIVE_HIGH>;
        echo-gpios = <&gpio4 19 GPIO_ACTIVE_HIGH>;
    };

